#include "screen.h"

#ifdef U8X8_HAVE_HW_SPI
#include <SPI.h>
#endif
#ifdef U8X8_HAVE_HW_I2C
#include <Wire.h>
#endif

/*
  U8g2lib Example Overview:
    Frame Buffer Examples: clearBuffer/sendBuffer. Fast, but may not work with all Arduino boards because of RAM consumption
    Page Buffer Examples: firstPage/nextPage. Less RAM usage, should work with all Arduino boards.
    U8x8 Text Only Example: No RAM usage, direct communication with display controller. No graphics, 8x8 Text only.
    
  This is a page buffer example.    
*/

// Please UNCOMMENT one of the contructor lines below
// U8g2 Contructor List (Picture Loop Page Buffer)
// The complete list is available here: https://github.com/olikraus/u8g2/wiki/u8g2setupcpp
// Please update the pin numbers according to your setup. Use U8X8_PIN_NONE if the reset pin is not connected
U8G2_SSD1306_128X64_NONAME_F_HW_I2C u8g2(U8G2_R0, /* reset=*/ U8X8_PIN_NONE);

// End of constructor list

// Coffee bean
#define cbean_16x16_width 16
#define cbean_16x16_height 16
static unsigned char cbean_16x16_bits[] U8X8_PROGMEM = {
   0x00, 0x1f, 0xc0, 0x3f, 0xf0, 0x3f, 0xf8, 0xbf, 0xfc, 0xdf, 0xfc, 0xef,
   0xfe, 0xf3, 0xfe, 0xf8, 0x3f, 0x7e, 0xcf, 0x7f, 0xf7, 0x3f, 0xfb, 0x3f,
   0xfd, 0x1f, 0xfc, 0x0f, 0xfc, 0x03, 0xf8, 0x00 };

// Lelit logo
#define lelit_logo_119x60_width 119
#define lelit_logo_119x60_height 60
static unsigned char lelit_logo_119x60_bits[] U8X8_PROGMEM = {
   0x00, 0x00, 0x00, 0x00, 0x00, 0x00, 0xf0, 0x7f, 0x00, 0x00, 0x00, 0x00,
   0x00, 0x00, 0x00, 0x00, 0x00, 0x00, 0x00, 0x00, 0x00, 0xfc, 0xff, 0x03,
   0x00, 0x00, 0x00, 0x00, 0x00, 0x00, 0x00, 0x00, 0x00, 0x00, 0x00, 0x00,
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   0xe0, 0xff, 0xff, 0x00, 0xfe, 0xff, 0x3f, 0x1f, 0x00, 0xf8, 0x00, 0x00 };

int downPos = 0;

void init_screen()
{
    // u8g2 init
  u8g2.setBusClock(400000);
  u8g2.begin();  
  u8g2.enableUTF8Print();

  // splash logo
  u8g2.clearBuffer();
  u8g2.drawXBMP(4,2, lelit_logo_119x60_width, lelit_logo_119x60_height, lelit_logo_119x60_bits);
  u8g2.sendBuffer();
  delay(10);
}

void update_page(int page, boolean grindActive, unsigned long time)
{
  u8g2.clearBuffer();
  // counting animation
  u8g2.setFont(u8g2_font_helvB24_te);
  u8g2.setCursor(40, 57);
  u8g2.print(time / 1000.0, 1);
  u8g2.print("s");
  u8g2.updateDisplayArea(5, 4, 11, 4);
  delay(10);

  // grinding animation
  if (grindActive)
  {
    u8g2.clearBuffer();
    if (9 < downPos)
    {
      downPos = 0;
    }
    //Serial.print("Current down position: ");
    //Serial.println(downPos);
    u8g2.setFont(u8g2_font_cu12_t_symbols);
    u8g2.drawGlyph(8, 58 + (downPos*3), 0x25be);
    downPos++;

    u8g2.updateDisplayArea(0, 6, 4, 2);
    delay(10);
  }
  else
  {
    downPos = 0;
  }
}

void draw_page(int page, boolean grinding, unsigned long time)
{
  u8g2.clearBuffer();
  // menu overview
  int btnSingleTime = U8G2_BTN_HCENTER|U8G2_BTN_BW2;
  int btnDoubleTime = U8G2_BTN_HCENTER|U8G2_BTN_BW2;
  switch (page)
  {
    case 0: btnSingleTime = U8G2_BTN_HCENTER|U8G2_BTN_INV|U8G2_BTN_BW2; break;
    case 1: btnDoubleTime = U8G2_BTN_HCENTER|U8G2_BTN_INV|U8G2_BTN_BW2; break;
    default: break;
  }
  u8g2.setFont(u8g2_font_helvB08_te);
  u8g2.drawButtonUTF8(32, 14, btnSingleTime, 60,  1,  1, "SINGLE");
  u8g2.drawButtonUTF8(96, 14, btnDoubleTime, 60,  1,  1, "DOUBLE");

  // bean or mug display
  if (0 < time)
  {
    if (1 == page)
    {
      // beans
      u8g2.drawXBMP(0,30, cbean_16x16_width, cbean_16x16_height, cbean_16x16_bits);
      u8g2.drawXBMP(17,30, cbean_16x16_width, cbean_16x16_height, cbean_16x16_bits);
    }
    else
    {
      // bean
      u8g2.drawXBMP(8,30, cbean_16x16_width, cbean_16x16_height, cbean_16x16_bits);
    }
  }
  else
  {
    // mug
      u8g2.setFont(u8g2_font_unifont_t_symbols);
      u8g2.drawGlyphX2(8, 52, 0x2615);
  }

/*
  if (1 == page)
  {
    if (0 < time)
    {
      // beans
      u8g2.drawXBMP(0,30, cbean_16x16_width, cbean_16x16_height, cbean_16x16_bits);
      u8g2.drawXBMP(17,30, cbean_16x16_width, cbean_16x16_height, cbean_16x16_bits);
    }
    else
    {
      // mug
      u8g2.setFont(u8g2_font_unifont_t_symbols);
      u8g2.drawGlyphX2(8, 52, 0x2615);
    }
  }
  else
  {
    if (0 < time)
    {
      // bean
      u8g2.drawXBMP(8,30, cbean_16x16_width, cbean_16x16_height, cbean_16x16_bits);
    }
    else
    {
      // mug
      u8g2.setFont(u8g2_font_unifont_t_symbols);
      u8g2.drawGlyphX2(8, 52, 0x2615);
    }
  }
  */

  // action description
  u8g2.setFont(u8g2_font_amstrad_cpc_extended_8f);
  u8g2.drawStr(40, 30, "Restzeit");

  u8g2.sendBuffer();
  delay(10);

  update_page(page, grinding, time);
}